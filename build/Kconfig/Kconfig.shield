## build/Kconfig/Kconfig.shield
```kconfig
osource "/home/ogu/workspace/prospector/zmk-config-LalaPadmini/zmk-rgbled-widget/boards/shields/*/Kconfig.shield"
osource "/home/ogu/workspace/prospector/zmk-config-LalaPadmini/prospector-zmk-module/boards/shields/*/Kconfig.shield"
osource "/home/ogu/workspace/prospector/zmk-config-LalaPadmini/zmk/app/boards/shields/*/Kconfig.shield"
osource "/home/ogu/workspace/prospector/zmk-config-LalaPadmini/config/boards/shields/*/Kconfig.shield"
```

## build/Kconfig/Kconfig.shield.defconfig
```kconfig
osource "/home/ogu/workspace/prospector/zmk-config-LalaPadmini/zmk-rgbled-widget/boards/shields/*/Kconfig.defconfig"
osource "/home/ogu/workspace/prospector/zmk-config-LalaPadmini/modules/prospector-zmk-module/boards/shields/*/Kconfig.defconfig"
osource "/home/ogu/workspace/prospector/zmk-config-LalaPadmini/zmk/app/boards/shields/*/Kconfig.defconfig"
osource "/home/ogu/workspace/prospector/zmk-config-LalaPadmini/config/boards/shields/*/Kconfig.defconfig"
```

## config/boards/shields/lalapadmini/Kconfig.defconfig
```kconfig
if SHIELD_LALAPADMINI_RIGHT

config ZMK_KEYBOARD_NAME
    default "Lalapadmini_R"

config ZMK_SPLIT_ROLE_CENTRAL
    default n

endif

if SHIELD_LALAPADMINI_LEFT

config ZMK_KEYBOARD_NAME
    default "Lalapadmini_L"

config ZMK_SPLIT_ROLE_CENTRAL
    default n

endif

if SHIELD_LALAPADMINI_LEFT || SHIELD_LALAPADMINI_RIGHT

config ZMK_SPLIT
    default y

endif

if SHIELD_LALAPADMINI_DONGLE

config ZMK_KEYBOARD_NAME
    default "Lalapadmini"

config ZMK_SPLIT_ROLE_CENTRAL
    default y

config ZMK_SPLIT_BLE_CENTRAL_PERIPHERALS
    default 2

endif

if SHIELD_LALAPADMINI_DONGLE || SHIELD_LALAPADMINI_LEFT || SHIELD_LALAPADMINI_RIGHT

config ZMK_SPLIT
    default y

endif
```

## config/west.yml
```yaml
manifest:
  remotes:
    - name: zmkfirmware
      url-base: https://github.com/zmkfirmware
    - name: ShiniNet
      url-base: https://github.com/ShiniNet/
    - name: caksoylar 
      url-base: https://github.com/caksoylar  
    - name: kot149
      url-base: https://github.com/kot149
    - name: prospector
      url-base: https://github.com/t-ogura
  projects:
    - name: zmk
      remote: zmkfirmware
      revision: main
      import: app/west.yml
    - name: cirque-input-module
      remote: ShiniNet
      revision: main
    - name: zmk-rgbled-widget
      remote: caksoylar
      revision: main
    - name: zmk-layout-shift
      remote: kot149
      revision: v1
    - name: prospector-zmk-module  
      remote: prospector
      revision: b466545
  self:
    path: config
```
